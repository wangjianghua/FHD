
#include "includes.h"


#if 1
const unsigned char lcd_disp_ram_welcome[LCD_DISP_RAM_SIZE]=
{
    /*-- 宽度x高度=128x64 --*/
    0xFF,0xFF,0xFF,0x07,0x07,0x07,0x07,0x07,0x07,0x07,0x07,0x07,0x07,0x07,0x07,0x07,
    0x07,0x07,0x07,0x87,0x07,0x07,0x07,0x07,0x07,0x07,0x07,0x07,0x07,0x07,0x87,0x87,
    0x87,0x07,0x07,0x07,0x07,0x87,0x87,0x87,0x87,0x87,0x07,0x07,0x07,0x07,0x07,0x07,
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    0xE0,0xE0,0xE0,0xE0,0xE0,0xE0,0xE0,0xE0,0xE0,0xE0,0xE0,0xE0,0xE0,0xFF,0xFF,0xFF,
};

#endif

#if 0
//**************delay************************************
void delay_nms(unsigned int n)
{
    OSTimeDly(n);
}


//***************send_data********************************
void data_send(unsigned char dat)
{
    unsigned char s,temp;
    int i;
    LCD_SCL_RST();
    s=dat;
    for(i=8;i>0;i--)
    { 
        LCD_SCL_RST();
        //NOP();
        //NOP();
        
        temp=s&0x80;
        if(temp)
        {
            LCD_SDA_SET();
        }
        else
        {
            LCD_SDA_RST();
        }

        LCD_SCL_SET();
        s=s<<1;
    }
}

//***************write command*****************************
void wr_com(unsigned char com)
{
    CPU_SR_ALLOC();
    CPU_INT_DIS();
    LCD_A0_RST();
    LCD_CS_RST();
    data_send(com);
    LCD_CS_SET();
    CPU_INT_EN();
}

//***************write data********************************
void wr_data(unsigned char dat)
{
    CPU_SR_ALLOC();
    CPU_INT_DIS();
    LCD_A0_SET();
    LCD_CS_RST();
    data_send(dat);
    LCD_CS_SET();
    CPU_INT_EN();
}

//**********************************************************
void display_kuang()
{
    unsigned char seg;
    unsigned char page;
    for(page=0xb0;page<0xb8;page++)
    {
        if(page==0xb0)
        {
            wr_com(page);
            wr_com(0x10);
            wr_com(0x00);
            for(seg=0;seg<128;seg++)
            {
                if(seg==0) wr_data(0xff);
                else if(seg==127) wr_data(0xff);
                else wr_data(0x01);
            }
        }
        else
        {
            if(page==0xb7)
            {
                wr_com(page);
                wr_com(0x10);
                wr_com(0x00);
                for(seg=0;seg<128;seg++)
                {
                    if(seg==0) wr_data(0xff);
                    else if(seg==127) wr_data(0xff);
                    else wr_data(0x80);
                }
            }

            else
            {
                wr_com(page);
                wr_com(0x10);
                wr_com(0x00);
                for(seg=0;seg<128;seg++)
                {
                    if(seg==0) wr_data(0xff);
                    else if(seg==127) wr_data(0xff);
                    else wr_data(0x00);
                }
            }
        }
    }
}


//**********************************************************
void display_lattice(unsigned char dat1,unsigned char dat2)
{
    unsigned char seg;
    unsigned char page;
    for(page=0xb0;page<0xb8;page++)
    {

        wr_com(page);
        wr_com(0x10);
        wr_com(0x00);
        for(seg=0;seg<64;seg++)
        { 
            wr_data(dat1);
            wr_data(dat2);
        }
    }

}


//**********************************************************
//**********************************************************
void display_map(unsigned char *p)
{
    unsigned char seg;
    unsigned char page;
    
    for(page=0xb0;page<0xb8;page++)
    {
        wr_com(page);
        wr_com(0x10);
        wr_com(0x00);

        for(seg=0;seg<128;seg++)
        { 
            wr_data(*p);
            ++p;
        }
    }

}

void lcd_init()
{
    LCM_CON_ON();
    //BLCD_CON_ON();
    delay_nms(100);
    LCD_RST();
    delay_nms(100);
    LCD_SET();
    delay_nms(100);

    //**********lcd inintial************
    wr_com(0xa0); //ADC normal
    wr_com(0xc8); //com normal
    wr_com(0xa3); //set partial display duty 1/65

    wr_com(0x2c); //vc on
    delay_nms(100);
    wr_com(0x2e); //vr on
    delay_nms(100);
    wr_com(0x2f); //internal booster,follower,divided on
    wr_com(0x25); //set rb/ra=5.29
    wr_com(0x81); //set reference voltage select
    wr_com(0x10);
    delay_nms(100);    
    wr_com(0xaf); //display on
    wr_com(0xa6); //display on
    wr_com(0x40); //set start line 00
    //BLCD_CON_OFF();
}
#else //华兄

/** 
 * @file     lcd.c
 * @brief    COG12864液晶屏显示
 * @details  ST7565R驱动
 * @author   华兄
 * @email    591881218@qq.com
 * @date     2014
 * @version  vX.XX
 * @par Copyright (c):  
 *           深圳市合尔凯科技有限公司
 * @par History:          
 *   version: author, date, desc\n 
 */

unsigned char lcd_disp_buf[LCD_YSIZE / 8][LCD_XSIZE];

void lcd_delay(unsigned int dly)
{
    OSTimeDly(dly);
}

void lcd_port_init(void)
{
    GPIO_InitTypeDef GPIO_InitStructure;


    GPIO_InitStructure.GPIO_Pin = GPIO_Pin_11 | GPIO_Pin_12;
    GPIO_InitStructure.GPIO_Mode = GPIO_Mode_Out_PP;
    GPIO_InitStructure.GPIO_Speed = GPIO_Speed_50MHz;
    GPIO_Init(GPIOA, &GPIO_InitStructure);

    GPIO_InitStructure.GPIO_Pin = GPIO_Pin_13 | GPIO_Pin_15;
    GPIO_InitStructure.GPIO_Mode = GPIO_Mode_Out_PP;
    GPIO_InitStructure.GPIO_Speed = GPIO_Speed_50MHz;
    GPIO_Init(GPIOB, &GPIO_InitStructure);    

    GPIO_InitStructure.GPIO_Pin = GPIO_Pin_5 | GPIO_Pin_8 | GPIO_Pin_9;
    GPIO_InitStructure.GPIO_Mode = GPIO_Mode_Out_PP;
    GPIO_InitStructure.GPIO_Speed = GPIO_Speed_50MHz;
    GPIO_Init(GPIOC, &GPIO_InitStructure);     
}

void lcd_send_byte(unsigned char byte)
{
    unsigned char i, temp;


    temp = byte;

    for(i = 0; i < 8; i++)
    {
        LCD_SCLK_RESET();

        if(temp & 0x80)
        {
            LCD_MOSI_SET();
        }
        else
        {
            LCD_MOSI_RESET();
        }

        LCD_SCLK_SET();

        temp <<= 1;
    }
}

void lcd_write_cmd(unsigned char cmd)
{   
    CPU_SR_ALLOC();
    

    CPU_INT_DIS();
    
    LCD_RS_RESET();
    LCD_CS_RESET();
    lcd_send_byte(cmd);
    LCD_CS_SET();

    CPU_INT_EN();
}

void lcd_write_data(unsigned char data)
{	
    CPU_SR_ALLOC();
    

    CPU_INT_DIS();
    
    LCD_RS_SET();
    LCD_CS_RESET();
    lcd_send_byte(data);
    LCD_CS_SET();

    CPU_INT_EN();
}

void lcd_clr_scr(void)
{
    unsigned char page, seg;

    
    for(page = 0xb0; page < 0xb8; page++)
    {
        lcd_write_cmd(page); //page
       
        lcd_write_cmd(0x10); //column
        
#if (REV_OPERATION_EN > 0U)
        lcd_write_cmd(0x04); //column
#else
        lcd_write_cmd(0x00); //column
#endif  

        for(seg = 0; seg < 128; seg++) //写128列
        {
            lcd_write_data(0x00);	
        }	
    }
}

void lcd_disp_map(unsigned char *pmap) //pmap是图片数据首地址
{
    unsigned char page, seg;

    
    for(page = 0xb0; page < 0xb8; page++)
    {
        lcd_write_cmd(page); //page
       
        lcd_write_cmd(0x10); //column
        
#if (REV_OPERATION_EN > 0U)
        lcd_write_cmd(0x04); //column
#else
        lcd_write_cmd(0x00); //column
#endif 

        for(seg = 0; seg < 128; seg++) //写128列
        {
            lcd_write_data(*pmap++);	
        }	
    }
}

void lcd_init(void)
{
    lcd_port_init();

    LCM_POW_ON();
    LCD_On();    

    lcd_delay(100);

    LCD_RST_RESET();
    lcd_delay(100);
    LCD_RST_SET();
    lcd_delay(100);

    lcd_write_cmd(0xe2); /*软复位*/
    lcd_delay(100);
    lcd_write_cmd(0x2c); /*升压步聚1*/
    lcd_delay(100);
    lcd_write_cmd(0x2e); /*升压步聚2*/
    lcd_delay(100);
    lcd_write_cmd(0x2f); /*升压步聚3*/
    lcd_delay(100);
    lcd_write_cmd(0x23); /*粗调对比度，可设置范围0x20～0x27*/
    lcd_write_cmd(0x81); /*微调对比度*/
    lcd_write_cmd(0x1a); /*微调对比度的值，可设置范围0x00～0x3f*/
    lcd_write_cmd(0xa3); /*1/7 偏压比（bias）*/

#if (REV_OPERATION_EN > 0U)    
    lcd_write_cmd(0xc0); /*行扫描顺序：从下到上*/
    lcd_write_cmd(0xa1); /*列扫描顺序：从右到左*/
#else
    lcd_write_cmd(0xc8); /*行扫描顺序：从上到下*/
    lcd_write_cmd(0xa0); /*列扫描顺序：从左到右*/
#endif    

    lcd_write_cmd(0x40); /*起始行：从第一行开始*/
    lcd_write_cmd(0xaf); /*开显示*/

    lcd_delay(100);

    lcd_clr_scr();
}

#endif
